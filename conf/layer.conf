## conf/layer.conf
```bitbake
# We have a conf and classes directory, add to BBPATH
BBPATH .= ":${LAYERDIR}"

# We have recipes-* directories, add to BBFILES
BBFILES += "${LAYERDIR}/recipes-*/*/*.bb \
            ${LAYERDIR}/recipes-*/*/*.bbappend"

BBFILE_COLLECTIONS += "meta-ketop"
BBFILE_PATTERN_meta-ketop = "^${LAYERDIR}/"
BBFILE_PRIORITY_meta-ketop = "6"

LAYERDEPENDS_meta-ketop = "core"
LAYERSERIES_COMPAT_meta-ketop = "hardknott honister"
```

## conf/machine/ketop.conf
```bitbake
#@TYPE: Machine
#@NAME: ketop

#@DESCRIPTION: Machine configuration for KeTop T155 X86_64 (64-bit) 

SERIAL_CONSOLE = "115200 ttyS0"
SERIAL_CONSOLES = "115200;ttyS0"

MACHINE_HWCODECS = "intel-vaapi-driver gstreamer1.0-vaapi"

require conf/machine/include/meta-intel.inc
require conf/machine/${X86_TUNE_DIR}/x86-base.inc
require conf/machine/${X86_TUNE_DIR}/arch-x86.inc
# require conf/machine/intel-corei7-64.conf

DEFAULTTUNE = "silvermont-64"

QEMU_UNAVAILABLE_ISA = " \
-mno-avx \
-mno-avx2 \
-mno-avx512f \
-mno-avx512er \
-mno-avx512cd \
-mno-avx512pf \
-mno-avx512dq \
-mno-avx512bw \
-mno-avx512vl \
-mno-avx512ifma \
-mno-avx512vbmi \
-mno-avx512vbmi2 \
-mno-avx512vnni \
-mno-avx512bitalg \
"

TUNEVALID[silvermont] = "Enable Intel Atom specific processor optimizations"
TUNE_CCARGS .= "${@bb.utils.contains('TUNE_FEATURES', 'silvermont', ' -march=silvermont -mtune=silvermont -mfpmath=sse -msse4.2', '', d)}" 

AVAILTUNES += "silvermont-64"
TUNE_FEATURES:tune-silvermont-64 = "${TUNE_FEATURES:tune-x86-64} silvermont"
BASE_LIB:tune-silvermont-64 = "lib64"
TUNE_PKGARCH:tune-silvermont-64 = "silvermont-64"
PACKAGE_EXTRA_ARCHS:tune-silvermont-64 = "${PACKAGE_EXTRA_ARCHS:tune-core2-64} silvermont-64"
QEMU_EXTRAOPTIONS_silvermont-64 = " -cpu Skylake-Client"

AVAILTUNES += "silvermont-32"
TUNE_FEATURES:tune-silvermont-32 = "${TUNE_FEATURES:tune-x86} silvermont"
BASE_LIB:tune-silvermont-32 = "lib"
TUNE_PKGARCH:tune-silvermont-32 = "silvermont-32"
PACKAGE_EXTRA_ARCHS:tune-silvermont-32 = "${PACKAGE_EXTRA_ARCHS:tune-core2-32} silvermont"
QEMU_EXTRAOPTIONS_silvermont-32 = " -cpu core2duo"

MACHINE_ESSENTIAL_EXTRA_RDEPENDS += " linux-firmware kernel-modules grub-common grub-editenv intel-vaapi-driver"


COMPATIBLE_MACHINE_ketop = "ketop"

MACHINE_FEATURES = " efi \
		      pcbios \
		      intel-ucode \
		      "
KERNEL_IMAGETYPE = "bzImage"
MACHINE_FEATURES:remove = "qemu-usermode"

MACHINE_EXTRA_RRECOMMENDS += " linux-firmware libva-utils"
KERNEL_EXTRA_FEATURES = ""
KERNEL_FEATURES = ""
KERNEL_FEATURES_INTEL_COMMON:remove = "cfg/virtio.scc"
KERNEL_FEATURES:remove = "cfg/virtio.scc"


# EFI_PROVIDER = "efibootguard"

UBOOT_CONFIG = "qemu-x86_64_defconfig"
GRUBPLATFORM = "efi"
GRUB_BUILDIN = "boot linux ext2 fat serial part_msdos part_gpt normal efi_gop iso9660 configfile search loadenv test "
GRUB_BUILDIN += "acpi squash4 all_video multiboot2"
GLIBC_ADDONS = "nptl"

WKS_FILE="ketop-dual-boot.wks"
WIC_CREATE_EXTRA_ARGS ?= "--no-fstab-update"
IMAGE_FSTYPES = "tar.gz "
```

## wic/ketop-dual-boot.wks
```
# short-description: Create an EFI disk image for ketop
# long-description: Creates a partitioned EFI disk image with dual boot, grub, data partition
part /boot --source bootimg-efi --sourceparams="loader=grub-efi,initrd=microcode.cpio" --fixed-size 128 --active --align 1024 --part-type C12A7328-F81F-11D2-BA4B-00A0C93EC93B 
part --source rootfs --fixed-size 3072M --label rootfs1 --part-name rootfs1 --fstype=ext4 --align 1024 --part-type 4F68BCE3-E8CD-4DB1-96E7-FBCAF984B709 
part --source rootfs --fixed-size 3072M --label rootfs2 --part-name rootfs2 --fstype=ext4 --align 1024 --part-type 4F68BCE3-E8CD-4DB1-96E7-FBCAF984B709 
part /mnt/data --size 128M --label data --part-name data --fstype=ext4

bootloader --configfile=grub.cfg --ptable gpt
```
